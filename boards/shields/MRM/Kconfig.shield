## config/west.yml
```yaml
manifest:
  remotes:
    - name: zmkfirmware
      url-base: https://github.com/zmkfirmware
    - name: caksoylar
      url-base: https://github.com/caksoylar
    - name: badjeff
      url-base: https://github.com/badjeff
    - name: te9no
      url-base: https://github.com/te9no
    - name: petejohanson
      url-base: https://github.com/petejohanson
  projects:
    - name: zmk
      # remote: zmkfirmware
      remote: te9no
      revision: main
      import: app/west.yml
    - name: zmk-rgbled-widget
      remote: caksoylar
      revision: main
    - name: zmk-pmw3610-driver
      remote: badjeff
      revision: main
    - name: zmk-analog-input-driver
      remote: badjeff
      revision: main
    - name: zmk-input-processor-keybind
      remote: te9no
      revision: main
    - name: cirque-input-module
      remote: petejohanson
      revision: main
  self:
    path: config
    
```
